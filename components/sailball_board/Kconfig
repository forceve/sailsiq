## components/sailball_board/Kconfig
```kconfig
menu "Sailball board configuration"

config SAILBALL_GNSS_SAMPLE_RATE_NUM
    int "Normalized GNSS sample rate numerator"
    range 1 10
    default 10

config SAILBALL_GNSS_SAMPLE_RATE_DEN
    int "Normalized GNSS sample rate denominator (tuning)"
    range 1 100
    default 1

config SAILBALL_BOARD_REVISION
    string "Hardware revision"
    default "USER_CONFIRMED_MAP_REVISION_UNSPECIFIED"

config SAILBALL_GNSS_UART1
    bool "Use UART1 for GNSS"
    default y

config SAILBALL_GNSS_TX_GPIO
    int "GNSS UART TX GPIO"
    range 0 21
    default 1

config SAILBALL_GNSS_RX_GPIO
    int "GNSS UART RX GPIO"
    range 0 21
    default 0

config SAILBALL_SD_SPI2_HOST
    bool "Use ESP32-C3 SPI2 host for SD/SDSPI"
    default y

config SAILBALL_SD_MOSI_GPIO
    int "SD MOSI GPIO"
    range 0 21
    default 5

config SAILBALL_SD_MISO_GPIO
    int "SD MISO GPIO"
    range 0 21
    default 7

config SAILBALL_SD_SCLK_GPIO
    int "SD SCLK GPIO"
    range 0 21
    default 6

config SAILBALL_SD_CS_GPIO
    int "SD CS GPIO"
    range 0 21
    default 4

config SAILBALL_SD_RESERVE_BYTES
    int "Free space reserve for continuing LDC commits"
    range 0 1048576
    default 65536

config SAILBALL_BOOT_GPIO
    int "BOOT button GPIO"
    range 0 21
    default 9

config SAILBALL_LED_GPIO
    int "WS2818B data GPIO"
    range 0 21
    default 8

endmenu
```

## components/sailball_diagnostics/Kconfig
```kconfig
menu "Sailball diagnostics"

config SAILBALL_VALIDATION_METRICS
    bool "Enable validation-only heap and stack metrics"
    default n
    help
        Track application task stack low-water marks and internal heap
        low-water/current fragmentation metrics during board validation.
        These metrics are not exposed by the Sailball Protocol.

endmenu
```

## components/sailball_gnss/Kconfig
```kconfig
menu "Sailball GNSS runtime target"

config SAILBALL_GNSS_RUNTIME_BAUD
    int "GNSS runtime UART baud"
    range 4800 115200
    default 115200

config SAILBALL_GNSS_UPDATE_RATE_HZ
    int "GNSS normalized update target (Hz)"
    range 1 10
    default 10

endmenu
```

## components/sailball_supervisor/Kconfig
```kconfig
menu "Sailball supervisor tuning"

config SAILBALL_PROGRESS_GNSS_STALL_MS
    int "GNSS receive progress timeout (ms)"
    range 1000 300000
    default 5000

config SAILBALL_PROGRESS_GNSS_RESTART_INTERVAL_MS
    int "GNSS local restart interval (ms)"
    range 5000 600000
    default 30000

config SAILBALL_PROGRESS_COMMIT_GRACE_MS
    int "Storage commit progress grace period (ms)"
    range 5000 120000
    default 30000

endmenu
```
